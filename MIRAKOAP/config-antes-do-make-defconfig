## MIRAKOAP/config-antes-do-make-defconfig
```kconfig
# Sistema alvo para Raspberry Pi 3
CONFIG_TARGET_ROOTFS_PARTSIZE=1000

CONFIG_TARGET_bcm27xx=y
CONFIG_TARGET_bcm27xx_bcm2710=y
CONFIG_TARGET_bcm27xx_bcm2710_DEVICE_rpi-3=y

# Pacotes básicos já selecionados
CONFIG_PACKAGE_base-files=y
CONFIG_PACKAGE_bcm27xx-gpu-fw=y
CONFIG_PACKAGE_bcm27xx-utils=y
CONFIG_PACKAGE_ca-bundle=y
CONFIG_PACKAGE_dnsmasq=y
CONFIG_PACKAGE_dropbear=y
CONFIG_PACKAGE_e2fsprogs=y
CONFIG_PACKAGE_firewall4=y
CONFIG_PACKAGE_fstools=y
CONFIG_PACKAGE_kmod-fs-vfat=y
CONFIG_PACKAGE_kmod-nft-offload=y
CONFIG_PACKAGE_kmod-nls-cp437=y
CONFIG_PACKAGE_kmod-nls-iso8859-1=y
CONFIG_PACKAGE_kmod-sound-arm-bcm2835=y
CONFIG_PACKAGE_kmod-sound-core=y
CONFIG_PACKAGE_kmod-usb-hid=y
CONFIG_PACKAGE_libc=y
CONFIG_PACKAGE_libgcc=y
CONFIG_PACKAGE_libustream-mbedtls=y
CONFIG_PACKAGE_logd=y
CONFIG_PACKAGE_mkf2fs=y
CONFIG_PACKAGE_mtd=y
CONFIG_PACKAGE_netifd=y
CONFIG_PACKAGE_nftables=y
CONFIG_PACKAGE_odhcp6c=y
CONFIG_PACKAGE_odhcpd-ipv6only=y
CONFIG_PACKAGE_opkg=y
CONFIG_PACKAGE_partx-utils=y
CONFIG_PACKAGE_ppp=y
CONFIG_PACKAGE_ppp-mod-pppoe=y
CONFIG_PACKAGE_procd-ujail=y
CONFIG_PACKAGE_uci=y
CONFIG_PACKAGE_uclient-fetch=y
CONFIG_PACKAGE_urandom-seed=y

# Firmware e drivers para Wi-Fi e USB
CONFIG_PACKAGE_cypress-firmware-43430-sdio=y
CONFIG_PACKAGE_brcmfmac-nvram-43430-sdio=y
CONFIG_PACKAGE_cypress-firmware-43455-sdio=y
CONFIG_PACKAGE_brcmfmac-nvram-43455-sdio=y
CONFIG_PACKAGE_kmod-brcmfmac=y
CONFIG_PACKAGE_wpad-basic-mbedtls=y
CONFIG_PACKAGE_hostapd-common=y

# Suporte a armazenamento e montagem automática
CONFIG_PACKAGE_block-mount=y
CONFIG_PACKAGE_kmod-usb-storage=y
CONFIG_PACKAGE_kmod-fs-ext4=y

# Servidor de arquivos (Samba) e gerenciamento via LuCI
CONFIG_PACKAGE_samba4-server=y
CONFIG_PACKAGE_luci-app-samba4=y

# Explorador de arquivos no LuCI (se disponível)
CONFIG_PACKAGE_luci-app-filebrowser=y

# Suporte para modems (QMI/CDC/Serial)
CONFIG_PACKAGE_kmod-usb-net-qmi-wwan=y
CONFIG_PACKAGE_uqmi=y
CONFIG_PACKAGE_luci-proto-qmi=y
CONFIG_PACKAGE_kmod-usb-net-cdc-mbim=y
CONFIG_PACKAGE_umbim=y
CONFIG_PACKAGE_luci-proto-mbim=y
CONFIG_PACKAGE_kmod-usb-serial=y
CONFIG_PACKAGE_kmod-usb-serial-option=y
CONFIG_PACKAGE_kmod-usb-serial-wwan=y
CONFIG_PACKAGE_comgt=y
CONFIG_PACKAGE_chat=y

# Ferramentas e utilitários de rede e diagnóstico
CONFIG_PACKAGE_iwinfo=y
CONFIG_PACKAGE_iw=y
CONFIG_PACKAGE_wireless-tools=y

# Pacotes para gerenciamento via LuCI e interface web
CONFIG_PACKAGE_luci=y
CONFIG_PACKAGE_luci-mod-admin-full=y
CONFIG_PACKAGE_luci-proto-3g=y
CONFIG_PACKAGE_luci-proto-ipv6=y
CONFIG_PACKAGE_luci-proto-ppp=y
CONFIG_PACKAGE_luci-app-openvpn=y
CONFIG_PACKAGE_luci-app-commands=y
CONFIG_PACKAGE_luci-app-nlbwmon=y
CONFIG_PACKAGE_luci-app-sqm=y
CONFIG_PACKAGE_arp-scan=y
CONFIG_PACKAGE_luci-app-ttyd=y
CONFIG_PACKAGE_nmap=y
CONFIG_PACKAGE_tcpdump=y
CONFIG_PACKAGE_luci-app-ddns=y
CONFIG_PACKAGE_ddns-scripts=y
CONFIG_PACKAGE_luci-app-firewall=y
CONFIG_PACKAGE_nano=y
CONFIG_PACKAGE_psmisc=y
CONFIG_PACKAGE_qmi-utils=y
CONFIG_PACKAGE_coreutils-stty=y
CONFIG_PACKAGE_kmod-ipt-nat=y
CONFIG_PACKAGE_kmod-nf-conntrack=y
CONFIG_PACKAGE_kmod-nf-nat=y
CONFIG_PACKAGE_kmod-nf-conntrack6=y
CONFIG_PACKAGE_kmod-nf-nathelper=y
CONFIG_PACKAGE_kmod-nf-nathelper-extra=y
CONFIG_PACKAGE_luci-app-upnp=y
CONFIG_PACKAGE_bmon=y
CONFIG_PACKAGE_vnstat=y
CONFIG_PACKAGE_iftop=y
CONFIG_PACKAGE_iperf3=y
CONFIG_PACKAGE_kmod-usb-net-cdc-ether=y

# Suporte para Node.js e npm
CONFIG_PACKAGE_node=y
CONFIG_PACKAGE_node-npm=y
CONFIG_PACKAGE_dockerd=y
CONFIG_PACKAGE_luci-app-dockerman=y
CONFIG_PACKAGE_gammu-smsd=y
CONFIG_PACKAGE_luci-app-smsd=y

CONFIG_PACKAGE_luci-app-vnstat=y

CONFIG_PACKAGE_wireguard=y
CONFIG_PACKAGE_luci-app-wireguard=y
CONFIG_PACKAGE_luci-app-zerotier=y
CONFIG_PACKAGE_luci-app-vpnc=y

CONFIG_PACKAGE_banip=y
CONFIG_PACKAGE_luci-app-banip=y
CONFIG_PACKAGE_nodogsplash=y
CONFIG_PACKAGE_luci-app-nodogsplash=y

CONFIG_PACKAGE_python3=y
CONFIG_PACKAGE_python3-pip=y

CONFIG_PACKAGE_collectd=y
CONFIG_PACKAGE_luci-app-collectd=y
CONFIG_PACKAGE_luci-app-vpn-policy-routing=y
CONFIG_PACKAGE_luci-app-statistics=y
```
